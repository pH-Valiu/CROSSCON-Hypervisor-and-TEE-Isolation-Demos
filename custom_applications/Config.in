## custom_applications/Config.in
```kconfig
source "$BR2_EXTERNAL_CROSSCON_HV_LINUX_VM_CA_PATH/package/helloworld/Config.in"
```

## custom_applications/nexmon/Config.in
```kconfig
config BR2_PACKAGE_NEXMON
	bool "nexmon"
	default y
	help
	  This packages requires Linux Kernel Version
	  5.10.92

	  https://github.com/nexmonster/nexmon_csi_bin/blob/main/

comment "nexmon requires Kernel 5.10.92"
```

## custom_applications/package/helloworld/Config.in
```kconfig
config BR2_PACKAGE_HELLOWORLD
	bool "helloworld"
	default y
	depends on BR2_TOOLCHAIN_BUILDROOT_CXX
	help
	  This is just a simple hello world program.
	  It serves the purpose of illustrating how
	  to include a custom user application in
	  buildroot.

	  http://nothing_here.com/

comment "helloworld needs a toolchain w/ C++"
```

## nexmon_automated_demo/custom_applications/Config.in
```kconfig
source "$BR2_EXTERNAL_CROSSCON_HV_LINUX_VM_CA_PATH/package/nexmon/Config.in"
source "$BR2_EXTERNAL_CROSSCON_HV_LINUX_VM_CA_PATH/package/automatic_nexmon_client/Config.in"
```

## nexmon_automated_demo/custom_applications/package/automatic_nexmon_client/Config.in
```kconfig
config BR2_PACKAGE_AUTOMATIC_NEXMON_CLIENT
        bool "automatic nexmon client"
        default n
	depends on BR2_INIT_BUSYBOX
	depends on BR2_PACKAGE_KMOD
        select BR2_PACKAGE_PYTHON3
	select BR2_PACKAGE_NEXMON
        help
	  Include all required files that make up a nexmon client
	  in the context of our CROSSCON use case fetching wifi csi
	  data. Added files include an automatic startup script and
	  a python script responsible for collecting nexmon output
	  and writing it to memory.

	  http://no-url.de

comment "automatic nexmon client needs a python3 and a Linux kernel to be built (v5.10.92-v8+)"
```

## nexmon_demo/custom_applications/package/nexmon/Config.in
```kconfig
config BR2_PACKAGE_NEXMON
	bool "nexmon"
	default y
	depends on BR2_INSTALL_LIBSTDCPP
	select BR2_PACKAGE_GMP
	select BR2_PACKAGE_QPDF
	help
	  Include the nexmon_csi library by adding the custom nexmon 
	  software and replacing the wifi brcmfmac driver.
	  This packages requires Linux Kernel Version 5.10.92

	  https://github.com/nexmonster/nexmon_csi_bin/blob/main/

comment "nexmon needs a toolchain w/ C++ and a Linux kernel to be built (v5.10.92)"
```
